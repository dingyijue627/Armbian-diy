// SPDX-License-Identifier: (GPL-2.0+ OR MIT)
/*
 * Copyright (c) 2021 Rockchip Electronics Co., Ltd.
 * 
 * Device Tree Source for LemonPi Pi1 board based on Rockchip RK3588 SoC.
 * Kernel Version Target: 6.14 test
 *
 */

#include "rk3588-lemonpi-pi1.dts"

/ {
	model = "SOM3588Cat";
	compatible = "rockchip,som3588-cat", "rockchip,rk3588";
};