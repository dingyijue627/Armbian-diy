// SPDX-License-Identifier: (GPL-2.0+ OR MIT)
/*
 * Copyright (c) 2021 Rockchip Electronics Co., Ltd
 * Device Tree Source for LemonPi board on Rockchip RK3588 SoC.
 *
 */

/dts-v1/;

#include "rk3588-u-boot.dtsi"

/ {
	chosen {
		u-boot,spl-boot-order = "same-as-spl", &sdhci;
	};
};

&sdhci {
	cap-mmc-highspeed;
	mmc-hs200-1_8v;
};

&saradc {
	status = "okay";
	vref-supply = <&avcc_1v8_s0>;
};
